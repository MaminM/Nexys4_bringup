/dts-v1/;
#include "pl.dtsi"
/ {
	board = "nexys4";
	compatible = "xlnx,nexys4-riscv" , "qemu,mbv" , "amd,mbv";
	device_id = "7a100t";
	#address-cells = <1>;
	variant = "artix7";
	model = "NEXYS4 AMD Microblaze RISCV 32bit";
	#size-cells = <1>;
	slrcount = <1>;
	family = "microblaze_riscv";
	speed_grade = "1";
	chosen {
	};
	aliases {
	};
	cpus_microblaze_riscv_0: cpus_microblaze_riscv@0 {
		address-map = <0x40000000 &axi_gpio_0 0x40000000 0x10000>;
		#ranges-address-cells = <0x1>;
		#ranges-size-cells = <0x1>;
	};
};
